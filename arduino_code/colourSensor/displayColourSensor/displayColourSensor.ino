#include "ssd1306.h"
#include "U8glib.h"
U8GLIB_SSD1306_128X64 u8g(U8G_I2C_OPT_NONE|U8G_I2C_OPT_DEV_0);  // I2C / TWI 

const uint8_t psiLit [] PROGMEM {
0x06, 0x06, 0x06, 0x0E, 0xFE, 0xFE, 0xFE, 0xFE, 0xFE, 0x0E, 0x0E, 0x0E, 0x0E, 0x0E, 0x0E, 0x0E,
0x0E, 0x1E, 0x1E, 0x7C, 0x7C, 0xF8, 0xF0, 0xF0, 0xE0, 0x80, 0x00, 0x00, 0x00, 0x00, 0x00, 0x00,
0x00, 0x80, 0xE0, 0xF0, 0x38, 0x1C, 0x0C, 0x06, 0x06, 0x07, 0x03, 0x03, 0x03, 0x03, 0x07, 0x07,
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0x00, 0x00, 0x00, 0x00
};

const uint8_t logoLit [] PROGMEM {
0x00, 0x00, 0x00, 0x00, 0x00, 0x00, 0x00, 0x00, 0x00, 0x00, 0x00, 0x00, 0x00, 0x00, 0x00, 0x00,
0x00, 0x00, 0x00, 0x00, 0x00, 0x00, 0x00, 0x80, 0x00, 0x00, 0x00, 0x00, 0x00, 0x80, 0x80, 0xA0,
0x00, 0x00, 0x00, 0x00, 0x00, 0x40, 0x00, 0x00, 0x00, 0x00, 0x00, 0x00, 0x80, 0x00, 0x00, 0x00,
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0x00, 0x00, 0x00, 0x00
};

char * receivedRfid = (char * ) malloc(sizeof(char) * 9);
char * receivedMsg = (char * ) malloc(sizeof(char) * 4);
unsigned long startTime = 0;
bool isActionHappened = false;
bool screenSaver = false;

bool isChecked = false;

void setup() {
  memset(receivedMsg, '\0', sizeof(receivedMsg));
  memset(receivedRfid, '\0', sizeof(receivedRfid));
  Serial.begin(115200);
  Serial.setTimeout(100);
  ssd1306_128x64_i2c_init();
  ssd1306_fillScreen(0x00);
  u8g.setFont(u8g_font_ncenB12);
  u8g.setColorIndex(1); // Instructs the display to draw with a pixel on. 
  u8g.firstPage();
  delay(1000);
}

void wait(int time) {
  time /= 100;
  for (int i = 0; i < time; i++) {
    Serial.readBytes(receivedMsg, 4);

    if (receivedMsg[0] != '\0') {
      //warning only 1 msg
      Serial.write("r\0", 2); //received
      Serial.flush();

      if (strcmp(receivedMsg, "rcd\0") == 0) {
        while (1) {
          Serial.readBytes(receivedRfid, 9);
          delay(20);
          if (receivedRfid[0] != '\0') {
            //warning only 1 msg
            Serial.write("r\0", 2); //received
            Serial.flush();
            memset(receivedMsg, '\0', sizeof(receivedMsg));
            while (Serial.available())
              Serial.read();
            id(receivedRfid);
            isActionHappened = true;
            return;
          }
        }
      }

      //warning maybe timer 
      while (Serial.available())
        Serial.read();

      if (strcmp(receivedMsg, "qtc\0") == 0) {
        memset(receivedMsg, '\0', sizeof(receivedMsg));
        qualityCheck(); //...
        isActionHappened = true;
        return;
      } else if (strcmp(receivedMsg, "qif\0") == 0) {
        isChecked = true;
        memset(receivedMsg, '\0', sizeof(receivedMsg));
        qualityCheckIsFinished();
        isActionHappened = true;
        return;
      } else if (strcmp(receivedMsg, "rdy\0") == 0) {
        memset(receivedMsg, '\0', sizeof(receivedMsg));
        isActionHappened = false;
        screenSaver = true;
        return;
      } else {
        qualityRes(receivedMsg);
        isActionHappened = true;
        return;
      }
    }
  }
}

bool stopAnim() {
  if (isChecked) {
    isChecked = false;
    return true;
  } else
    return false;
}

void animation() {
  while (1) {
    for (int i = 48; i < 55; i++) {
      ssd1306_putPixels(i, 49, 0xFF);
    }
    wait(200);
    if (stopAnim()) {
      break;
    }
    for (int i = 60; i < 67; i++) {
      ssd1306_putPixels(i, 49, 0xFF);
    }
    wait(200);
    if (stopAnim()) {
      break;
    }
    for (int i = 72; i < 79; i++) {
      ssd1306_putPixels(i, 49, 0xFF);
    }
    wait(200);
    if (stopAnim()) {
      break;
    }
    ssd1306_clearBlock(48, 49 / 8, 7, 8);
    ssd1306_clearBlock(60, 49 / 8, 7, 8);
    ssd1306_clearBlock(72, 49 / 8, 7, 8);
    wait(200);
    if (stopAnim())
      break;
  }
}

void qualityRes(char res[]) {
  ssd1306_fillScreen(0x00);
  u8g.firstPage();
  u8g.setFont(u8g_font_ncenB14);
  if (res[0] == '0') {
    do {
      u8g.drawStr(18, 40, "No defect"); //14
    } while (u8g.nextPage());
  } else if (res[0] == '1') {
    do {
      u8g.drawStr(32, 25, "Defect"); //14
      u8g.drawStr(27, 50, "type #1");
    } while (u8g.nextPage());
  } else if (res[0] == '2') {

    do {
      u8g.drawStr(32, 25, "Defect"); //14
      u8g.drawStr(27, 50, "type #2");
    } while (u8g.nextPage());
  } else if (res[0] == 'e') {
    u8g.setFont(u8g_font_ncenB12);
    do {
      u8g.drawStr(3, 16, "Problem with"); //12
      u8g.drawStr(5, 36, "quality check.");
      u8g.drawStr(5, 56, "Pls, try again.");
    } while (u8g.nextPage());
  }

  memset(receivedMsg, '\0', sizeof(receivedMsg));
}

void qualityCheck() {
  ssd1306_fillScreen(0x00);
  u8g.setFont(u8g_font_ncenB12);
  u8g.firstPage();
  do {
    u8g.drawStr(5, 30, "Quality check");
  } while (u8g.nextPage());
  animation();
}
void qualityCheckIsFinished() {
  ssd1306_fillScreen(0x00);
  u8g.setFont(u8g_font_ncenB12);
  u8g.firstPage();
  do {
    u8g.drawStr(6, 25, "Quality check"); //12
    u8g.drawStr(20, 50, "is finished");
  } while (u8g.nextPage());
}
void id(char rfidArr[]) {
  ssd1306_fillScreen(0x00);
  u8g.setFont(u8g_font_ncenB12);
  u8g.firstPage();
  do {
    u8g.drawStr(52, 16, "ID"); //12
    u8g.drawStr(23, 36, rfidArr);
    u8g.drawStr(25, 56, "received");
  } while (u8g.nextPage());
  memset(receivedRfid, '\0', sizeof(receivedRfid));
}

void mainCheck() {
  if (isActionHappened) {
    screenSaver = false;
    while (1) {
      isActionHappened = false;
      startTime = millis();
      while (millis() - startTime < 300000 && isActionHappened == false && screenSaver == false)
      //5 min waiting then screensaver
      {
        wait(10000);
      }
      if (!isActionHappened) {
        ssd1306_fillScreen(0x00);
        break;
      }

    }
  }
}

void loop() {
  //Serial.println();
  //Serial.println(freeRam());
  //Serial.println();

  ssd1306_fillScreen(0x00);
  ssd1306_drawBitmap(25, 1, 80, 50, psiLit);
  wait(2000);
  mainCheck();
  ssd1306_fillScreen(0x00);
  ssd1306_drawBitmap(25, 1, 80, 50, logoLit);
  wait(2000);
  mainCheck();
  ssd1306_fillScreen(0x00);
  u8g.setFont(u8g_font_ncenB12);
  u8g.firstPage();
  do {
    u8g.drawStr(17, 25, "Waiting for"); //12
    u8g.drawStr(9, 50, "new material");
  } while (u8g.nextPage());
  wait(2000);
  mainCheck();

}

int freeRam() {
  extern int __heap_start, * __brkval;
  int v;
  return (int) & v - (__brkval == 0 ? (int) & __heap_start : (int) __brkval);
}

//u8g.drawStr( 17, 25, "Waiting for");//12
//u8g.drawStr( 9, 50, "new material");

//u8g.drawStr( 25, 25, "Material");//14
//u8g.drawStr( 23, 50, "detected");

//u8g.drawStr( 8, 16, "Please, move");//12
//u8g.drawStr( 25, 36, "material");
//u8g.drawStr( 30, 56, "right -->");

//u8g.drawStr( 8, 16, "Moving to");//12
//u8g.drawStr( 5, 36, "RFID Reader");
//u8g.drawStr( 33, 56, "<-- left");

//u8g.drawStr( 40, 25, "RFID");//14
//u8g.drawStr( 23, 50, "674516f2");

//u8g.drawStr( 40, 25, "Valid");//14
//u8g.drawStr( 39, 50, "RFID");

//u8g.drawStr( 32, 25, "Invalid");//14
//u8g.drawStr( 39, 50, "RFID");

//u8g.drawStr( 8, 40, "Forwarding");//14

//u8g.drawStr( 20, 30, "Dropping");//14

//u8g.drawStr( 23, 40, "Dropped");//14

//u8g.drawStr( 25, 25, "Position:");//14
//u8g.drawStr( 39, 50, "20 cm");
//u8g.drawStr( 46, 50, "2 cm");

//u8g.drawStr( 18, 13, "Waiting for");//12
//u8g.drawStr( 35, 33, "rolling");

//u8g.drawStr( 22, 25, "Ready to");//14
//u8g.drawStr( 48, 50, "roll");

//u8g.drawStr( 7, 25, "Manual mode");//12
//u8g.drawStr( 47, 50, "OFF");